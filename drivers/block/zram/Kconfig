## drivers/block/zram/Kconfig
```kconfig
# SPDX-License-Identifier: GPL-2.0
config ZRAM
	tristate "Compressed RAM block device support"
	depends on BLOCK && SYSFS && ZSMALLOC && CRYPTO
	select CRYPTO_LZ4
	default n
	help
	  Creates virtual block devices called /dev/zramX (X = 0, 1, ...).
	  Pages written to these disks are compressed and stored in memory
	  itself. These disks allow very fast I/O and compression provides
	  good amounts of memory savings.

	  It has several use cases, for example: /tmp storage, use as swap
	  disks and maybe many more.

	  See Documentation/blockdev/zram.txt for more information.


choice
	prompt "Default zram compressor"
	default ZRAM_DEF_COMP_LZ4
	depends on ZRAM

config ZRAM_DEF_COMP_ZSTD
	bool "zstd"
	depends on CRYPTO_ZSTD

config ZRAM_DEF_COMP_LZ4
	bool "lz4"
	depends on CRYPTO_LZ4

config ZRAM_DEF_COMP_LZO
	bool "lzo"
	depends on CRYPTO_LZO

config ZRAM_DEF_COMP_LZ4HC
	bool "lz4hc"
	depends on CRYPTO_LZ4HC

config ZRAM_DEF_COMP_842
	bool "842"
	depends on CRYPTO_842

config ZRAM_DEF_COMP_LZ4K
	bool "lz4k"
	depends on CRYPTO_LZ4K

config ZRAM_DEF_COMP_LZ4KD
	bool "lz4kd"
	depends on CRYPTO_LZ4KD

config ZRAM_DEF_COMP_DEFLATE
	bool "deflate"
	depends on CRYPTO_DEFLATE

endchoice

config ZRAM_DEF_COMP
	string
	default "zstd" if ZRAM_DEF_COMP_ZSTD
	default "lz4" if ZRAM_DEF_COMP_LZ4
	default "lzo" if ZRAM_DEF_COMP_LZO
	default "lz4hc" if ZRAM_DEF_COMP_LZ4HC
	default "842" if ZRAM_DEF_COMP_842
	default "lz4k" if ZRAM_DEF_COMP_LZ4K
	default "lz4kd" if ZRAM_DEF_COMP_LZ4KD
	default "deflate" if ZRAM_DEF_COMP_DEFLATE

config ZRAM_WRITEBACK
       bool "Write back incompressible or idle page to backing device"
       depends on ZRAM
       default n
       help
	 With incompressible page, there is no memory saving to keep it
	 in memory. Instead, write it out to backing device.
	 For this feature, admin should set up backing device via
	 /sys/block/zramX/backing_dev.

	 With /sys/block/zramX/{idle,writeback}, application could ask
	 idle page's writeback to the backing device to save in memory.

	 See Documentation/blockdev/zram.txt for more information.

config ZRAM_MEMORY_TRACKING
	bool "Track zRam block status"
	depends on ZRAM && DEBUG_FS
	help
	  With this feature, admin can track the state of allocated blocks
	  of zRAM. Admin could see the information via
	  /sys/kernel/debug/zram/zramX/block_state.

	  See Documentation/blockdev/zram.txt for more information.
```

## drivers/misc/mediatek/perf_common/Kconfig
```kconfig
config MTK_PERF_COMMON
	bool "MTK system performance common feature"
	help
	  CONFIG_MTK_PERF_COMMON provides common entrypoint to support
	  multiple the system performance features and it can easily
	  extend. The trigger period is aligned to sched-tick. If you are
	  not sure about whether to enable it or not, please set n.


config MTK_PERF_TRACKER
	bool "MTK system performance index support"
	depends on MTK_PERF_COMMON
	help
	  CONFIG_PERF_TRACKER define if system performance index should
	  be built-in or not. It supports system related performance index
	  via trace. If you are not sure about whether to enable it or not,
	  please set n.

config MTK_PERF_TRACKER_TRACE
	bool "Enable perf tracker tracepoints"
	depends on MTK_PERF_TRACKER
	default n
	help
	  Select this to build perf tracker tracepoint instrumentation.
	  Leave disabled on production builds to avoid the runtime overhead
	  of tracepoint registration and data snapshots.

config MTK_CORE_CTL
	bool "MTK Core Control with CPU Isolation"
	depends on MTK_SCHED_EXTENSION
	help
	  This config is for the core control policy with CPU isolation.
	  The core control online and offline CPU cores based on task
	  utilizations from scheduler information automatically.
	  If you are not sure about whether to enable it or not,
	  please set n.
```
